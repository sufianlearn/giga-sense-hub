## waveshare-hub/sdkconfig.defaults
```kconfig
# ESP32-S3 with PSRAM
CONFIG_IDF_TARGET="esp32s3"
CONFIG_SPIRAM=y
CONFIG_SPIRAM_MODE_OCT=y
CONFIG_SPIRAM_SPEED_80M=y
CONFIG_ESP_DEFAULT_CPU_FREQ_MHZ_240=y

# WiFi
CONFIG_ESP_WIFI_SOFTAP_ENABLED=y
CONFIG_ESP_WIFI_NVS_ENABLED=y

# Partition table
CONFIG_PARTITION_TABLE_CUSTOM=y
CONFIG_PARTITION_TABLE_CUSTOM_FILENAME="partitions.csv"

# LWIP - increase sockets for multi-stream
CONFIG_LWIP_MAX_SOCKETS=16
CONFIG_LWIP_SO_RCVBUF=y
CONFIG_LWIP_TCP_MSS=1460

# FreeRTOS
CONFIG_FREERTOS_HZ=1000

# HTTP client
CONFIG_ESP_HTTP_CLIENT_ENABLE_HTTPS=n

# LVGL fonts
CONFIG_LV_FONT_MONTSERRAT_12=y
CONFIG_LV_FONT_MONTSERRAT_14=y
CONFIG_LV_FONT_MONTSERRAT_16=y
CONFIG_LV_FONT_MONTSERRAT_18=y
CONFIG_LV_FONT_MONTSERRAT_20=y
CONFIG_LV_FONT_MONTSERRAT_24=y
CONFIG_LV_FONT_MONTSERRAT_28=y

# LVGL widgets
CONFIG_LV_USE_MENU=y
CONFIG_LV_USE_KEYBOARD=y
CONFIG_LV_USE_TABVIEW=y
CONFIG_LV_USE_MSGBOX=y
CONFIG_LV_USE_LIST=y
CONFIG_LV_USE_SPINNER=y

# LVGL color
CONFIG_LV_COLOR_DEPTH_16=y
CONFIG_LV_THEME_DEFAULT_DARK=y

# LVGL memory - use stdlib
CONFIG_LV_MEM_CUSTOM=y

# Flash size
CONFIG_ESPTOOLPY_FLASHSIZE_8MB=y
```
